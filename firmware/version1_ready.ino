// =========================
// Generated by chatgpt on 02 04 2026 (prompt by Oki Aryawan)
// =========================

#include <Arduino.h>
#include <ESP32Servo.h>
#include "HX711.h"

// =========================
// PIN CONFIG
// =========================
#define MOTOR_PIN 25
#define HX711_DT 4
#define HX711_SCK 5
#define LED_BUILTIN 2

// =========================
// ESC CONFIG
// =========================
#define ESC_MIN_US 1000
#define ESC_MAX_US 2000

// =========================
// TEST CONFIG
// =========================
#define PWM_MAX 100
#define STEP_SIZE 5
#define SAMPLING_MS 1000

// =========================
// HX711 CONFIG
// =========================
float calibration_factor = -201;
#define THRUST_MAX 2000

// =========================
// OBJECTS
// =========================
Servo ESC;
HX711 scale;

// =========================
// GLOBAL VARIABLES
// =========================
bool isRunning = false;
int pwm = 0;
unsigned long lastSampleTime = 0;

// =========================
// FUNCTIONS
// =========================

// Send JSON data (for Streamlit plot)
void sendData(int pwm, int thrust) {
  Serial.print("{\"pwm\":");
  Serial.print(pwm);
  Serial.print(",\"gram\":");
  Serial.print(thrust);
  Serial.println("}");
}

// Send status message
void sendStatus(String msg) {
  Serial.print("STATUS:");
  Serial.println(msg);
}

// Read HX711
int readThrust() {
  if (!scale.is_ready()) {
    sendStatus("HX711_NOT_READY");
    return 0;
  }

  float val = scale.get_units(5);
  if (val < 0) val = 0;

  return constrain((int)val, 0, THRUST_MAX);
}

// Set ESC PWM
void setMotor(int percent) {
  percent = constrain(percent, 0, 100);
  int us = map(percent, 0, 100, ESC_MIN_US, ESC_MAX_US);
  ESC.writeMicroseconds(us);
}

// =========================
// COMMAND HANDLER
// =========================
void processCommand(String cmd) {
  cmd.trim();
  cmd.toUpperCase();

  sendStatus("CMD_" + cmd);

  if (cmd == "START") {
    isRunning = true;
    pwm = 0;
    setMotor(0);
    digitalWrite(LED_BUILTIN, HIGH);
    sendStatus("START_OK");
  }

  else if (cmd == "STOP") {
    isRunning = false;
    pwm = 0;
    setMotor(0);
    digitalWrite(LED_BUILTIN, LOW);
    sendStatus("STOP_OK");
  }

  else if (cmd == "TARE") {
    sendStatus("TARING");
    scale.tare();
    sendStatus("TARE_DONE");
  }

  else if (cmd.startsWith("SET_PWM_")) {
    int val = cmd.substring(8).toInt();
    val = constrain(val, 0, 100);

    setMotor(val);
    sendStatus("PWM_SET_" + String(val));
  }

  else if (cmd.startsWith("SET_CALIB_")) {
    calibration_factor = cmd.substring(11).toFloat();
    scale.set_scale(calibration_factor);

    sendStatus("CALIB_SET_" + String(calibration_factor));
  }

  else {
    sendStatus("UNKNOWN_" + cmd);
  }
}

// =========================
// SETUP
// =========================
void setup() {
  Serial.begin(115200);

  pinMode(LED_BUILTIN, OUTPUT);

  // ESC init
  ESC.setPeriodHertz(50);
  ESC.attach(MOTOR_PIN, ESC_MIN_US, ESC_MAX_US);
  setMotor(0);

  // HX711 init
  scale.begin(HX711_DT, HX711_SCK);
  scale.set_scale(calibration_factor);

  sendStatus("TARING_ON_START");
  delay(2000);
  scale.tare();

  if (scale.is_ready()) {
    sendStatus("HX711_READY");
  } else {
    sendStatus("HX711_NOT_READY");
  }

  sendStatus("SYSTEM_READY");
}

// =========================
// LOOP
// =========================
void loop() {

  // === SERIAL COMMAND ===
  if (Serial.available()) {
    String cmd = Serial.readStringUntil('\n');
    processCommand(cmd);
  }

  // === TEST LOOP ===
  if (isRunning) {

    if (millis() - lastSampleTime >= SAMPLING_MS) {
      lastSampleTime = millis();

      int thrust = readThrust();

      // send to Streamlit
      sendData(pwm, thrust);

      // next step
      pwm += STEP_SIZE;

      if (pwm > PWM_MAX) {
        isRunning = false;
        pwm = 0;
        setMotor(0);
        digitalWrite(LED_BUILTIN, LOW);

        sendStatus("TEST_DONE");
      } else {
        setMotor(pwm);
      }
    }
  }
}
